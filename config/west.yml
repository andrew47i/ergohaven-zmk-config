## config/west.yml
```yaml
manifest:
  remotes:
    - name: ergohaven
      url-base: https://github.com/ergohaven
    - name: jewtvet
      url-base: https://github.com/jewtvet
  projects:
    - name: ergohaven-zmk
      remote: ergohaven
      revision: main
      import: config/west.yml
    - name: zmk-ruen
      remote: jewtvet
      revision: main
  self:
    path: config
```
